/ {
    chosen {
        zmk,kscan = &kscan0;
    };

    kscan0: kscan {
        compatible = "zmk,kscan-gpio-matrix";
        diode-direction = "row2col";

        row-gpios = <
            &gpio0 6  (GPIO_ACTIVE_LOW | GPIO_PULL_UP)   /* ROW0 */
            &gpio0 8  (GPIO_ACTIVE_LOW | GPIO_PULL_UP)   /* ROW1 */
            &gpio0 17 (GPIO_ACTIVE_LOW | GPIO_PULL_UP)   /* ROW2 */
            &gpio0 20 (GPIO_ACTIVE_LOW | GPIO_PULL_UP)   /* ROW3 */
        >;

        col-gpios = <
            &gpio0 22 GPIO_ACTIVE_LOW
            &gpio0 24 GPIO_ACTIVE_LOW
            &gpio1 0  GPIO_ACTIVE_LOW
            &gpio0 11 GPIO_ACTIVE_LOW
            &gpio1 4  GPIO_ACTIVE_LOW
            &gpio1 6  GPIO_ACTIVE_LOW
            &gpio0 9  GPIO_ACTIVE_LOW
            &gpio0 10 GPIO_ACTIVE_LOW
            &gpio1 11 GPIO_ACTIVE_LOW
            &gpio1 13 GPIO_ACTIVE_LOW
            &gpio1 15 GPIO_ACTIVE_LOW
            &gpio0 2  GPIO_ACTIVE_LOW
        >;
    };
};

